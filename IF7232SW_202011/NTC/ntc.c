#include "ntc.h"

eResult aboveZeroFlag = TRUE;
//	MF52E 10K at 25, B = 3950, ADC = 12 bits9
const uint16_t igbtTempTable[]={
		223 ,	//;-30	0
		236 ,	//;-29	1
		249 ,	//;-28	2
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		3973,	//;130	160		
};

#if 0
const uint16_t coilTempTable[]={
		22 ,	//;-30  0
		23 ,	//;-29  1
		25 ,	//;-28  2
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		3223,	//;130  160
};
#endif

const uint16_t coilTempTable[]={
	
120 ,   // 	0
126 ,   // 	1
133 ,   // 	2
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4064,   //	320
};


#if 0
/*
 * 函数名：get_temperature
 * 描述  ：计算温度
 * 输入  ：12bit的ADC值
 * 返回  : 计算结果: 0对应-30.0度, 300对应0度, 550对应25.0度, 最大1600对应130.0度
 */
#define		D_SCALE		10		//结果放大倍数, 放大10倍就是保留一位小数
uint16_t	get_temperature(uint16_t adc)
{
	uint16_t  const *p;
	uint16_t  i;
	uint8_t   j,k,min,max;
	
	adc = 4096 - adc;	//Rt接地
	p = igbtTempTable;
	if(adc < p[0])		return (0xfffe);
	if(adc > p[160])	return (0xffff);
	
	min = 0;		//-40度
	max = 160;		//120度

	for(j=0; j<5; j++)	//采用二分法查表
	{
		k = min / 2 + max / 2;
		if(adc <= p[k])	max = k;
		else			min = k;
	}
		 if(adc == p[min])	i = min * D_SCALE;
	else if(adc == p[max])	i = max * D_SCALE;
	else	// min < temp < max
	{
		while(min <= max)
		{
			min++;
			if(adc == p[min])	{i = min * D_SCALE;	break;}
			else if(adc < p[min])
			{
				min--;
				i = p[min];	//min
				j = (adc - i) * D_SCALE / (p[min+1] - i);
				i = min;
				i *= D_SCALE;
				i += j;
				break;
			}
		}
	}
	return i;
}

/*
 * 函数名：calculated_Temperature
 * 描述  ：根据AD值计算温度
 * 输入  ：12位AD值
 * 返回  : 温度值, bit15为“1”表示温度为负数
 */
#define		TEMP_PRECISION		0		//输出精度，1：保留一位小数（个位数表示小数部分）  0：只输出整数部分
uint16_t calculated_Temperature(uint16_t adc_val)
{
		uint16_t temp;
	
		temp =	get_temperature(adc_val);	//计算温度值

		if(temp >= 300)		temp -= 300;		//温度 >= 0度
		else			      	temp  = (300 - temp);	//温度 <  0度
	
#if TEMP_PRECISION
		return temp;
#else
		return (temp/10);
#endif
}

#endif


/*
 * 函数名：get_temperature
 * 描述  ：计算温度
 * 输入  ：adc 12bit的ADC值，e_NtcType NTC的类型，IGBT是10k NTC，线盘的蘑菇头是100k NTC
 * 返回  : 计算结果: 0对应0度, 320对应320度
 */
#define		D_SCALE		10		//结果放大倍数, 放大10倍就是保留一位小数
uint16_t	lookUpNtcTable(uint16_t adc, enum ntcType e_ntc_type)
{
	uint16_t  const *p;
	uint16_t  i;
	uint16_t   j,k,min,max;
	
	adc = 4096 - adc;	//Rt接地
	if(e_ntc_type == IGBT_NTC)
	{
			p = igbtTempTable;
	}
	else if(e_ntc_type == COIL_NTC)
	{
			p = coilTempTable;
	}
	if(adc < p[0])		return (0xfffe);
	if(adc > p[320])	return (0xffff);
	
	min = 0;		//0度
	max = 320;		//300度

	for(j=0; j<6; j++)	//采用二分法查表
	{
		k = min / 2 + max / 2;
		if(adc <= p[k])	max = k;
		else			min = k;
	}
		 if(adc == p[min])	i = min * D_SCALE;
	else if(adc == p[max])	i = max * D_SCALE;
	else	// min < temp < max
	{
		while(min <= max)
		{
			min++;
			if(adc == p[min])	{i = min * D_SCALE;	break;}
			else if(adc < p[min])
			{
				min--;
				i = p[min];	//min
				j = (adc - i) * D_SCALE / (p[min+1] - i);
				i = min;
				i *= D_SCALE;
				i += j;
				break;
			}
		}
	}
	return i;
}

/*
 * 函数名：calculated_Temperature
 * 描述  ：根据AD值计算温度
 * 输入  ：12位AD值
 * 返回  : 温度值, bit15为“1”表示温度为负数
 */
#define		TEMP_PRECISION		0		//输出精度，1：保留一位小数（个位数表示小数部分）  0：只输出整数部分
uint16_t getTemperature(uint16_t adc_val, enum ntcType e_ntc_type)
{
		uint16_t temp;

		temp = lookUpNtcTable(adc_val, e_ntc_type);	//计算温度值
	
		/* AD有问题直接返回错误代号 */
		if(temp == 0xfffe)        return  NTC_ERROR_OPEN;
		else if(temp == 0xffff)		return  NTC_ERROR_SHORT_CIRCUIT;

//		if(temp >= 300)		temp -= 300, aboveZeroFlag = TRUE;		//温度 >= 0度
//		else			      	temp  = (300 - temp), aboveZeroFlag = FALSE;	//温度 <  0度
	
#if TEMP_PRECISION
		return temp;
#else
		return (temp/10);
#endif
}
